## CMakeLists.txt
```
cmake_minimum_required(VERSION 3.20.0)
find_package(Zephyr REQUIRED HINTS $ENV{ZEPHYR_BASE})
project(hello_timer)
target_sources(app PRIVATE src/main.c)
```

## Kconfig
```
menu "Hello Timer Options"

config HELLO_PERIOD_MS
    int "Período do timer (ms)"
    default 1000
    help
      Intervalo em milissegundos para o disparo periódico do timer
      que imprime a mensagem 'Hello World'.

endmenu

# IMPORTANTE: inclui os símbolos do Zephyr (LOG, etc.)
rsource "Kconfig.zephyr"
```

## Kconfig.zephyr
```
source "$ZEPHYR_BASE/Kconfig.zephyr"
```

## prj.conf
```kconfig
# --- Logging ---
CONFIG_LOG=y
# 0=none, 1=err, 2=wrn, 3=inf, 4=dbg
CONFIG_LOG_DEFAULT_LEVEL=3

# --- Período default do timer (ms) ---
CONFIG_HELLO_PERIOD_MS=1000
```

## src/main.c
```c
#include <zephyr/kernel.h>
#include <zephyr/logging/log.h>
#include <zephyr/sys/atomic.h>

LOG_MODULE_REGISTER(app);           /* usa CONFIG_LOG_DEFAULT_LEVEL */
#define HELLO_PERIOD_MS CONFIG_HELLO_PERIOD_MS

static struct k_timer hello_timer;
static atomic_t tick = ATOMIC_INIT(0);

static void hello_timer_cb(struct k_timer *timer)
{
    int t = atomic_inc(&tick);

    LOG_INF("Hello World! period=%dms tick=%d", HELLO_PERIOD_MS, t);
    LOG_DBG("Debug details: uptime=%u ms", (unsigned)k_uptime_get_32());

    if ((t % 5) == 0) {
        LOG_ERR("Simulated error (tick=%d). Demonstração de níveis de log.", t);
    }
}

static void hello_timer_stop_cb(struct k_timer *timer) { }

int main(void)
{
    k_timer_init(&hello_timer, hello_timer_cb, hello_timer_stop_cb);
    k_timer_start(&hello_timer, K_MSEC(HELLO_PERIOD_MS), K_MSEC(HELLO_PERIOD_MS));

    while (1) {
        k_sleep(K_SECONDS(1));
    }
}
```
